## conf/layer.conf
```bitbake
# We have a conf and classes directory, add to BBPATH
BBPATH .= ":${LAYERDIR}"

# We have recipes-* directories, add to BBFILES
BBFILES += "${LAYERDIR}/recipes-*/*/*.bb \
            ${LAYERDIR}/recipes-*/*/*.bbappend"

BBFILE_COLLECTIONS += "aaeon-nxp-imx8-layer"
BBFILE_PATTERN_aaeon-nxp-imx8-layer = "^${LAYERDIR}/"
BBFILE_PRIORITY_aaeon-nxp-imx8-layer = "6"

LAYERDEPENDS_aaeon-nxp-imx8-layer = "core freescale-layer"
LAYERSERIES_COMPAT_aaeon-nxp-imx8-layer = "scarthgap"
```

## conf/machine/srg-imx8p-a11-02.conf
```bitbake
#@TYPE: MACHINE
#@NAME: SRG-iMX8P-A11-02
#@DESCRIPTION: SRG-iMX8P-A11-02 Machine Configuration
#@SOC: i.MX8P

require conf/machine/include/srg-imx8p-a11-common.inc 

MACHINE = "srg-imx8p-a11-02"
MACHINE_BASE = "srg-imx8p-a11"
```
